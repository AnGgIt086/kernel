## drivers/gpu/drm/mediatek/Kconfig
```kconfig
config DRM_MEDIATEK
	tristate "DRM Support for Mediatek SoCs"
	depends on DRM
	depends on COMMON_CLK
	depends on HAVE_ARM_SMCCC
	depends on OF
	select DRM_GEM_CMA_HELPER
	select DRM_KMS_HELPER
	select DRM_MIPI_DSI
	select DRM_PANEL
	select MEMORY
	select MTK_SMI
        select FONT_SUPPORT
	select GENERIC_PHY
	help
	  Choose this option if you have a Mediatek SoCs.
	  The module will be called mediatek-drm
	  This driver provides kernel mode setting and
	  buffer management to userspace.

config DRM_MEDIATEK_HDMI
	tristate "DRM HDMI Support for Mediatek SoCs"
	depends on DRM_MEDIATEK
	select SND_SOC_HDMI_CODEC if SND_SOC
	select GENERIC_PHY
	help
	  DRM/KMS HDMI driver for Mediatek SoCs

config MTK_HDR_COLOR_GAIN_RGB
	hex "Config CCORR parameters for HDR layers"
	default 0
	help
	  This control color gain for hdr screen.
	  0~11 bit for blue gain.
	  12~23 bit for green gain.
	  24~63 bit for red gain.

config MTK_PQ_COLOR_MODE
	string "Config PQ_COLOR_MODE (MDP & DISP COLOR on/off)"
	default "DISP"
	help
	  This control mdp color on/off and disp color on/off
	  if value equals to DISP, only display color is on.
	  if value equals to MDP, only mdp color is on.
	  if value equals to DISP_MDP, mdp and display color are both on.
	  if value equals to OFF, mdp and display color are both off.

config DRM_MTK_SHADOW_REGISTER_SUPPORT
	bool "DRM shadow register Support for Mediatek SoCs"
	depends on DRM_MEDIATEK
	help
	  DRM shadow register Support for Mediatek SoCs.
	  define CONFIG_DRM_MTK_SHADOW_REGISTER_SUPPORT to
	  enable Shadow Register on display.
	  This feature will de-risk configuration time shortage.
	  If you want to use Shadow Register on display,
	  please make sure it is Y in xxx_defconfig.
	  This feature depends on Mediatek SoCs HW spec.
	  If unsure, set N.

config DRM_MTK_DISABLE_AEE_LAYER
	bool "Disable AEE Layer for the customer who don't want to produce AEE"
	help
	  Disable AEE Layer if you do not want to produce AEE.
	  Default Mediatek SoCs will produce AEE when exception occurred.
	  if this value is y, will not produce AEE.
	  if this value is n, will produce AEE.
	  If you do not produce AEE, please set it to Y in xxx_defconfig.
config VIVO_BACKLIGHT_SUPPORT_LM3697
	bool "LM3697(KTD3137) Support"
	default n
	---help---
	  LED driver for lm3697(KTD3137) support.
	  Set y to support.
	  Set n to disable.
config VIVO_I2C_BACKLIGHT_CURRENT_21MA
	bool "LM3697(KTD3137) Support 21MA CURRENT"
	default n
	---help---
	  LED driver for lm3697(KTD3137) support.
	  Set y to support.
	  Set n to disable.
config VIVO_LCM_LM3697_LED_3_FEEDBACK
	bool "LM3697(KTD3137) Support Led 3 keys"
	default n
	---help---
	  LED driver for lm3697(KTD3137) support led 3 keys.
	  Set y to support.
	  Set n to disable.
config VIVO_LCM_LM3697_LED_FULL_AW650NIT
	bool "LM3697(AW99703C) Support Led FULL 650NIT"
	default n
	---help---
	  LED driver for lm3697(AW99703C) support led full 650nit.
	  Set y to support.
	  Set n to disable.
config VIVO_LCM_DCDC_SUPPORT
	bool "bias dcdc Support"
	default n
	---help---
	  bias driver for avdd avee support.
	  Set y to support.
	  Set n to disable.
config VIVO_READ_DDIC_REG
	bool "read DDIC panel_reg"
	default n
	help
	read DDIC panel_reg for pd2202


config MTK_MT6382_BDG

	bool "Support Bridge IC 6382"
	help
	  This config decide if device with BridgeIC 6382
	  BridgeIC 6382 can support VESA-1.2 DSC, compressing display framedata
	  Normal project will disable it first
	  If you are not sure about this, do not set it to y

config DRM_PANEL_PD2215_SAMSUNG_S6E3FC3_FHDP_CMD
	bool "PD2215 samsung s6e3fc3 cmd mode panel"
	default n
	help
	  the first panel for pd2215

config DRM_PANEL_PD2257_SAMSUNG_S6E8FC3_FHDP_VIDEO
    bool "PD2257 samsung s6e8fc3 vdo mode panel"
    default n
    help
      the first panel for PD2257

config DRM_PANEL_PD2204_RM692E5_FHDP_CMD_BOE
	bool "PD2204 RM692E5 cmd mode panel"
	default n
	help
	  the first panel for PD2204

config DRM_PANEL_PD2204_EA8079P_FHDP_CMD_SAMSUNG
	bool "PD2204 EA8079P cmd mode panel"
	default n
	help
	  the second panel for PD2204

config DRM_PANEL_PD2230A_BOE_ICN9911C_HDPLUS_VIDEO
	bool "PD2230A BOE ICN9911C HD video mode panel"
	default n
	help
		the first panel for pd2230a

config DRM_PANEL_PD2230_TXD_FT8016_HDPLUS_VIDEO
	bool "PD2230 TXD FT8016 HD video mode panel"
	default n
	help
		the second panel for pd2230a

config DRM_PANEL_PD2230_TM_ILI7807S_FHDPLUS_VIDEO
	bool "PD2230 TM ILI7807S FHD+ video mode panel"
	default n
	help
		the first panel for pd2230

config DRM_PANEL_PD2230_HX_FT8720P_FHDPLUS_VIDEO
	bool "PD2230 HX FT8720P FHD+ video mode panel"
	default n
	help
	  the second panel for pd2230

config DRM_PANEL_PD2250_TM_ILI7807S_FHDPLUS_VIDEO
	bool "PD2250 TM ILI7807S FHD+ video mode panel"
	default n
	help
		the first panel for pd2250

config DRM_PANEL_PD2250_BOE_ICN9911C_HDPLUS_VIDEO
	bool "PD2250 BOE ICN9911C HD video mode panel"
	default n
	help
		the first panel for pd2250

config DRM_PANEL_PD2279_TM_ILI7807S_FHDPLUS_VIDEO
	bool "PD2279 TM ILI7807S FHD+ video mode panel"
	default n
	help
		the first panel for pd2279

config DRM_PANEL_PD2279_HX_NT36672C_FHDPLUS_VIDEO
	bool "PD2279F_EX HX NT36672C FHD+ video mode panel"
	default n
	help
		the first panel for pd2279f_ex

config DRM_PANEL_PD2279_TM_ILI7807S_CPHY_FHDPLUS_VIDEO
	bool "PD2279 TM ILI7807S CPHY FHD+ video mode panel"
	default n
	help
		the first panel for pd2279a

config VIVO_LCM_SWITCH_PORCH
	bool "switch hfp,send cmd and switch vfp at the same time"
	default n
	help
	  for video screen, needs to cut hfp,send cmd and switch vfp at the same time

config DRM_PANEL_PD2166_JDI_ILI7807S_FHDPLUS_VIDEO
	bool "PD2166 JDI ILI7807S FHD+ video mode panel"
	default n
	help
	  the second panel for pd2166

config DRM_PANEL_PD2166_TM_ILI7807S_FHDPLUS_VIDEO
	bool "PD2166 TM ILI7807S FHD+ video mode panel"
	default n
	help
	  the first panel for pd2166

config DRM_PANEL_PD2282_BOE_NT37705_FHDP_CMD
	bool "PD2282 boe nt37705 cmd mode panel,LTPO"
	default n
	help
	  the first panel for pd2282
```

## drivers/input/fingerprint/Kconfig
```kconfig
menuconfig BBK_FINGERPRINT
	tristate "BBK FINGERPRINT support"
	help
	  Say Y here to enable fingerprint

if BBK_FINGERPRINT
config BBK_FP_MODULE
	bool "BBK fingerprint modules"
	help 
	  Say Y here to enable fingerprint modules
	
config BBK_FP_ID
	tristate "detect fingerprint id"
	help
	  there is nothing for help!

source "drivers/input/fingerprint/gf3208/Kconfig"

source "drivers/input/fingerprint/fpc1511/Kconfig"
source "drivers/input/fingerprint/fpc1552/Kconfig"
source "drivers/input/fingerprint/ft9391/Kconfig"

source "drivers/input/fingerprint/gf3626/Kconfig"

source "drivers/input/fingerprint/icnf7312/Kconfig"

source "drivers/input/fingerprint/gsl7001/Kconfig"

source "drivers/input/fingerprint/nvt16605/Kconfig"

source "drivers/input/fingerprint/gf9578/Kconfig"

source "drivers/input/fingerprint/gf3956/Kconfig"
source "drivers/input/fingerprint/icnf7312/Kconfig"
source "drivers/input/fingerprint/ec617/Kconfig"
endif
```

## drivers/input/fingerprint/ec617/Kconfig
```kconfig
#
# fp_sensor driver configuration
#
config BBK_EC617
	tristate "egis fingerPrint sensor"
	help
		add for support egis FP Sensor.
```

## drivers/misc/mediatek/extcon/Kconfig
```kconfig
config EXTCON_MTK_USB
	tristate "MediaTek EXTCON USB Support"
	select EXTCON
	select USB_ROLE_SWITCH
	help
	  Say Y here to enable extcon support for USB cable detection
	  on the Mediatek PMIC.
config  VIVO_FORCE_USB_DEVICE
	tristate "MediaTek EXTCON FORCE USB"
	select EXTCON
	help
	  Say Y here to enable extcon force usb if
	  charge not configure properly
config VIVO_USB_OTG_ALARM
	tristate "Vivo USB OTG alarm Support"
	select EXTCON
	help
	  Say Y here to enable USB OTG alarm Support
```

## drivers/misc/mediatek/lcm/Kconfig
```kconfig
config MTK_LCM
	bool "Enable LCM driver"
	default n
	help
	  define LCM driver config to enable LCM driver.
	  To set LCM driver which you choose avoid cannot driver LCM.
	  Please make sure CONFIG_MTK_LCM in xxxxxx_defconfig.mk.
	  And also make sure true on in ProjectConfig.mk

config CUSTOM_KERNEL_LCM
	string "define mediatek kernel LCM driver"
	help
	  To choose kernel LCM driver name.
	  This config is to select which LCM driver you want to use.
	  Please make sure CUSTOME_KERNEL_LCM in xxxxx_defconfig.mk.
	  And also make sure turn on in ProjectConfig.mk

config MTK_LCM_DEVICE_TREE_SUPPORT
	bool "support LCM device tree connect with display drivers"
	help
	  Decide whether to support LCM device tree based configuration.
	  This feature requires the connection between display driver and LCM devices.
	  Please also turn on MTK_LCM_DEVICE_TREE_SUPPORT in ProjectConfig.mk.
	  If not define MTK_LCM_DEVICE_TREE_SUPPORT
	  there will not connect between display driver and LCM devices.

config LCM_MODULE_SUPPORT
	tristate "LCM Driver Info"
	help
	  Say Y here to enable lcm driver info interface.

config VIVO_BIT32_AAL_12_BIT
	bool "AAL 12 Bit support"
	default n
	help
	  for aal 12 bit support

config VIVO_BIT32_AAL_11_BIT
	bool "AAL 11 Bit support"
	default n
	help
	  for aal 11 bit support

config VIVO_LCM_ESD_CHECK_DISABLE
	bool "lcm esd check disable"
	default n
	help
	  for lcm esd check disable

config VIVO_LM3697
	bool "LM3697(KTD3137) Support 21MA CURRENT"
	default n
	---help---
	  LED driver for lm3697(KTD3137) support.
	  Set y to support.
	  Set n to disable.

config VIVO_LCM_LM3697_LED_3_FEEDBACK
	bool "LM3697 Support 3 feedback"
	default n
	depends on VIVO_LM3697
	---help---
		 LED driver for lm3697(KTD3137) support 3 feedback.
		 Set y to support.
		 Set n to disable.

config VIVO_I2C_BACKLIGHT_CURRENT_21MA
	bool "LM3697 Support 21MA Current Backlight"
	default n
	depends on VIVO_LM3697
	---help---
		LED driver for lm3697(KTD3137) support 21ma current backlight.
		Set y to support.
		Set n to disable.
config VIVO_I2C_BACKLIGHT_CUST_MODE_PD2281
	bool "LM3697 get boot mode API for recovery"
	default n
	depends on VIVO_LM3697
	---help---
		LED driver for lm3697(KTD3137) support cust get boot mode api.
		failed get recovery mode causing the screen not to light up
		Set y to support.
		Set n to disable.
```

## drivers/misc/mediatek/sensors-1.0/Kconfig
```kconfig
config VIVO_SENSOR_SCP_RESET_ENABLE
	bool "enable vivo scp reset mechanism"
	default n
	help
		when enable vivo scp reset mechanism
config CONFIG_VIVO_SAR_FOR_2140
    bool "enable vivo sar"
	default n
	help
	    when enable vivo sar

source "drivers/misc/mediatek/sensors-1.0/accelerometer/Kconfig"
source "drivers/misc/mediatek/sensors-1.0/alsps/Kconfig"
source "drivers/misc/mediatek/sensors-1.0/gyroscope/Kconfig"
source "drivers/misc/mediatek/sensors-1.0/magnetometer/Kconfig"
source "drivers/misc/mediatek/sensors-1.0/hwmon/Kconfig"
source "drivers/misc/mediatek/sensors-1.0/barometer/Kconfig"
source "drivers/misc/mediatek/sensors-1.0/sensorfusion/Kconfig"
source "drivers/misc/mediatek/sensors-1.0/step_counter/Kconfig"
source "drivers/misc/mediatek/sensors-1.0/situation/Kconfig"
source "drivers/misc/mediatek/sensors-1.0/sensorHub/Kconfig"
source "drivers/misc/mediatek/sensors-1.0/sensorfusion/Kconfig"
```

## drivers/misc/mediatek/thermal/Kconfig
```kconfig
config MTK_LEGACY_THERMAL
	bool "Use MTK legacy thermal code"
	help
	  Upstream thermal code and legacy thermal
	  code are not compatiable. As a result,
	  add a new switch MTK_LEGACY_THERMAL to replace
	  CONFIG_THERMAL for MTK legacy thermal code.

config MTK_THERMAL_PA_VIA_ATCMD
	bool "Thermal switch for query modem RF temp"
	depends on MTK_LEGACY_THERMAL
	help
	  Internal switch for thermal management
	  to query modem RF temperature
	  via AT command.
	  (RIL sockets)

config MTK_LEGACY_THERMAL_PLATFORM
	string "MTK legacy thermal platform name"
	depends on MTK_LEGACY_THERMAL
	help
	  To separate platform codes for legacy thermal
	  drivers. Config platform name for your
	  selection. It's used for legacy thermal
	  drivers only.

config PD2230_BOARD_TEMP
	bool "Thermal switch for query AP bts temp"
	help
	  Internal switch for PD2230 Board Temp
	  to query AP bts temperature

config REMOVE_MTKT_FLASH_LIGHT_PD2282
	bool "removing mtkt_flash_light or not"
	default n
	help
	  remove mtkt_flash_light for PD2282

config PD2281F_BOARD_TEMP
	bool "Thermal switch for query AP bts temp"
	help
	  Internal switch for PD2281F Board Temp
	  to query AP bts temperature
```

## sound/soc/mediatek/fs1599/Kconfig
```kconfig
config SND_SOC_FS1599
	tristate "SoC Audio for FS1599 Smart K PA"
	depends on I2C
	default n
	help
	  This option enables support for FS1599 Smart K PA.
```

## sound/soc/vivo/typec/Kconfig
```kconfig
config MTK_TYPEC_ACCDET
	bool "MediaTek TYPEC ACCDET driver"
	help
	  TYPEC ACCDET driver is for headset detect and support for MediaTek SOC
	  If you want to use MediaTek TYPEC ACCDET driver,
	  say Y.
	  If unsure, say N.
config SND_SOC_MAX20328
	tristate "max20328 for USB Type-C Audio Adapter Accessories"
	depends on I2C
	select MTK_TYPEC_ACCDET
	help
	  The MAX20328 are USB Type-C audio interface ICs for use in portable devices
```
